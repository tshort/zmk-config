## config/boards/arm/link-up/Kconfig.board
```kconfig
# Jiran BLE Lite board configuration

# Copyright (c) 2021 The ZMK Contributors
# SPDX-License-Identifier: MIT

config BOARD_LINK-UP_LEFT
	bool "link-up_left"
	depends on SOC_NRF52840_QIAA

config BOARD_LINK-UP_RIGHT
	bool "link-up_right"
	depends on SOC_NRF52840_QIAA

config BOARD_LINK-UP_MID
	bool "link-up_mid"
	depends on SOC_NRF52840_QIAA
```

## config/boards/arm/link-up/Kconfig.defconfig
```kconfig
# Copyright (c) 2021 The ZMK Contributors
# SPDX-License-Identifier: MIT

if BOARD_LINK-UP_LEFT
	config ZMK_KEYBOARD_NAME
	default "Link-Up Ortho Board"

config ZMK_SPLIT_ROLE_CENTRAL
	default y

endif # BOARD_LINK-UP_LEFT


if BOARD_LINK-UP_LEFT || BOARD_LINK-UP_RIGHT

config BOARD
	default "link-up"

config ZMK_SPLIT
	default y

menuconfig SENSOR
    bool "Sensor Drivers"

config BT_CTLR
	default BT

config ZMK_BLE
	default y

config ZMK_USB
	default y

if USB

config USB_NRFX
	default y

config USB_DEVICE_STACK
	default y

endif # USB

endif # BOARD_LINK-UP_LEFT || BOARD_LINK-UP_RIGHT
```
