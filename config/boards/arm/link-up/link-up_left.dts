/*
 * Copyright (c) 2021 The ZMK Contributors
 *
 * SPDX-License-Identifier: MIT
 */

#include "link-up.dtsi"

&kscan0 {
	compatible = "zmk,kscan-gpio-direct";
	label = "KSCAN";
    input-gpios
        = <&gpio0 30 (GPIO_ACTIVE_LOW | GPIO_PULL_UP)>
        , <&gpio0  7 (GPIO_ACTIVE_LOW | GPIO_PULL_UP)>
        , <&gpio0 21 (GPIO_ACTIVE_LOW | GPIO_PULL_UP)>
        , <&gpio1  0 (GPIO_ACTIVE_LOW | GPIO_PULL_UP)>
        , <&gpio0 10 (GPIO_ACTIVE_LOW | GPIO_PULL_UP)>

        , <&gpio0 29 (GPIO_ACTIVE_LOW | GPIO_PULL_UP)>
        , <&gpio0  5 (GPIO_ACTIVE_LOW | GPIO_PULL_UP)>
        , <&gpio0 23 (GPIO_ACTIVE_LOW | GPIO_PULL_UP)>
        , <&gpio0 22 (GPIO_ACTIVE_LOW | GPIO_PULL_UP)>
        , <&gpio1  4 (GPIO_ACTIVE_LOW | GPIO_PULL_UP)>

        , <&gpio0 28 (GPIO_ACTIVE_LOW | GPIO_PULL_UP)>
        , <&gpio0  4 (GPIO_ACTIVE_LOW | GPIO_PULL_UP)>
        , <&gpio0 12 (GPIO_ACTIVE_LOW | GPIO_PULL_UP)>
        , <&gpio0 18 (GPIO_ACTIVE_LOW | GPIO_PULL_UP)>
        , <&gpio1  2 (GPIO_ACTIVE_LOW | GPIO_PULL_UP)>

        , <&gpio0  2 (GPIO_ACTIVE_LOW | GPIO_PULL_UP)>
        , <&gpio0 31 (GPIO_ACTIVE_LOW | GPIO_PULL_UP)>
        , <&gpio1  9 (GPIO_ACTIVE_LOW | GPIO_PULL_UP)>
        , <&gpio0 19 (GPIO_ACTIVE_LOW | GPIO_PULL_UP)>
        , <&gpio1  1 (GPIO_ACTIVE_LOW | GPIO_PULL_UP)>

        , <&gpio1 11 (GPIO_ACTIVE_LOW | GPIO_PULL_UP)>
        , <&gpio1 13 (GPIO_ACTIVE_LOW | GPIO_PULL_UP)>
        , <&gpio1 15 (GPIO_ACTIVE_LOW | GPIO_PULL_UP)>
        , <&gpio0  3 (GPIO_ACTIVE_LOW | GPIO_PULL_UP)>
        , <&gpio1  3 (GPIO_ACTIVE_LOW | GPIO_PULL_UP)>
            ;
};
